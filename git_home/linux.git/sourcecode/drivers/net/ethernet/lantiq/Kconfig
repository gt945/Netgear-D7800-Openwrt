## git_home/linux.git/sourcecode/drivers/net/ethernet/lantiq/Kconfig
```kconfig
config NET_VENDOR_LANTIQ
        bool "Lantiq network devices"
        default y
        ---help---
          If you have a network (Ethernet) card belonging to this class, say Y
          and read the Ethernet-HOWTO, available from
          <http://www.tldp.org/docs.html#howto>.

if NET_VENDOR_LANTIQ

config LANTIQ_VRX320
	tristate "VRX320 SmartPHY PCIe EP driver"
	default n
	---help---
	Supported VRX320 smartPHY PCIe EP

config LANTIQ_VRX320_TEST
	tristate "VRX320 SmartPHY PCIe EP driver test module"
	default n
	---help---
	VRX320 smartPHY PCIe EP test module

endif # NET_VENDOR_LANTIQ
```

## package/datalib/Config.in
```kconfig
config datalib_WITH_nvram
	bool "create nvram command"
	default n
	help
	  create nvram command, it's a soft link to /bin/config in generally.

config datalib_WITH_readycloud_nvram
	bool "create readycloud_nvram command"
	default n
	help
	  create readycloud_nvram command, it's a soft link to /bin/config in generally.

config datalib_SPACE_SIZE
	string "Space size for datalib memory"
	default "0x60000"
	help
	  specify datalib's memory space size, 
```

## package/dnibusybox/Config.in
```kconfig
source "package/dnibusybox/target-config.in"
source "package/dnibusybox/config/Config.in"
```

## package/dsl-cpe-api-vrx/Config.in
```kconfig
menu "Configuration"
	depends on PACKAGE_dsl-cpe-api-vrx

	choice
		prompt "Device selection"
		default dsl-cpe-api-vrx_DEVICE_VR9
		help
		  Selection of a device.

	config dsl-cpe-api-vrx_DEVICE_VR9
		bool "VRX200"
		help
		  Actiavtes build for VRX200 Family.

	config dsl-cpe-api-vrx_DEVICE_VR10
		bool "VRX300"
		help
		  Actiavtes build for VRX300 Family.

	config dsl-cpe-api-vrx_DEVICE_VR10_320
		bool "VRX320"
		help
		  Actiavtes build for VRX300 Family, sunfamily VRX320.

	  endchoice

	choice
		prompt "build model"
		default dsl-cpe-api-vrx_MODEL_FULL
		help
		  Selection of a model (predefined combination of configure options).

	config dsl-cpe-api-vrx_MODEL_LITE
		bool "Lite"
		help
		  Minimum features included.
		  This model should ONLY demonstrate the minimum possible size.

	config dsl-cpe-api-vrx_MODEL_FOOTPRINT
		bool "Footprint"
		help
		  Defined for low footprint applications.

	config dsl-cpe-api-vrx_MODEL_TYPICAL
		bool "Typical"
		help
		  Defined for most typical use.

	config dsl-cpe-api-vrx_MODEL_FULL
		bool "Full"
		help
		  Includes all features but NOT all debug functionalities.

	config dsl-cpe-api-vrx_MODEL_DEBUG
		bool "Debug"
		help
		  Includes all features AND debug functionalities.
	endchoice

	menu "optional build options"
		depends on PACKAGE_dsl-cpe-api-vrx
	config dsl-cpe-api-vrx_USE_ADDITIONAL_BUILD_OPTIONS
		depends on PACKAGE_dsl-cpe-api-vrx
		bool "Use additional build options"
		default n
		help
		  Provides the possibility to include/exclude single features directly.
		  This configuration overwrites selections which are done by the "build model" configuration.

	config dsl-cpe-api-vrx_ADDITIONAL_BUILD_OPTIONS
		depends on dsl-cpe-api-vrx_USE_ADDITIONAL_BUILD_OPTIONS
		string "Additional build options"
		help
		  Defines to include/exclude single feature using available configure options.
		  Please refer to the documentation of the DSL CPE API "Configure options for the DSL CPE API"
	endmenu
endmenu
```

## package/dsl-cpe-control-vrx/Config.in
```kconfig
menu "Configuration"
	depends on PACKAGE_dsl-cpe-control-vrx

	choice
		prompt "Device selection"
		default dsl-cpe-control-vrx_DEVICE_VR9
		help
		  Selection of a device.

	config dsl-cpe-control-vrx_DEVICE_VR9
		bool "VRX200"
		help
		  Actiavtes build for VRX200 Family.

	config dsl-cpe-control-vrx_DEVICE_VR10
		bool "VRX300"
		help
		  Actiavtes build for VRX300 Family.

	config dsl-cpe-control-vrx_DEVICE_VR10_320
		bool "VRX320"
		help
		  Actiavtes build for VRX300 Family, VRX320 subfamily

	  endchoice

	config dsl-cpe-control-vrx_DTI
		bool "Include DTI"
		select PACKAGE_lib-dti
		default n
		help
		  Defines to include/exclude the Debug & Trace Interface.

	choice
		prompt "build model"
		default dsl-cpe-control-vrx_MODEL_FOOTPRINT
		help
		  Selection of a model (predefined combination of configure options).

	config dsl-cpe-control-vrx_MODEL_LITE
		bool "Lite"
		help
		  Minimum features included.
		  This model should ONLY demonstrate the minimum possible size.

	config dsl-cpe-control-vrx_MODEL_FOOTPRINT
		bool "Footprint"
		select dsl-cpe-control-vrx_DTI
		help
		  Defined for low footprint applications.

	config dsl-cpe-control-vrx_MODEL_TYPICAL
		bool "Typical"
		select dsl-cpe-control-vrx_DTI
		help
		  Defined for most typical use.

	config dsl-cpe-control-vrx_MODEL_FULL
		bool "Full"
		select dsl-cpe-control-vrx_DTI
		help
		  Includes all features but NOT all debug functionalities.

	config dsl-cpe-control-vrx_MODEL_DEBUG
		bool "Debug"
		select dsl-cpe-control-vrx_DTI
		help
		  Includes all features AND debug functionalities.
	endchoice

	menu "optional build options"
		depends on PACKAGE_dsl-cpe-control-vrx
	config dsl-cpe-control-vrx_USE_ADDITIONAL_BUILD_OPTIONS
		bool "Use additional build options"
		default n
		help
		  Provides the possibility to include/exclude single features directly.
		  This configuration overwrites selections which are done by the "build model" configuration.

	config dsl-cpe-control-vrx_ADDITIONAL_BUILD_OPTIONS
		depends on dsl-cpe-control-vrx_USE_ADDITIONAL_BUILD_OPTIONS
		string "Additional build options"
		help
		  Defines to include/exclude single feature using available configure options.
		  Please refer to the documentation of the DSL CPE API "Configure options for the DSL CPE API"

	endmenu
endmenu
```

## package/dsl-cpe-mei-vrx/Config.in
```kconfig
menu "Configuration"
	depends on PACKAGE_dsl-cpe-mei-vrx

	choice
		prompt "Device selection"
		default dsl-cpe-mei-vrx_DEVICE_VR9
		help
		  Selection of a device.

	config dsl-cpe-mei-vrx_DEVICE_VR9
		bool "VRX200"
		help
		  Actiavtes build for VRX200 Family.

	config dsl-cpe-mei-vrx_DEVICE_VR10
		bool "VRX300"
		help
		  Actiavtes build for VRX300 Family.

	config dsl-cpe-mei-vrx_DEVICE_VR10_320
		bool "VRX320"
		help
		  Actiavtes build for VRX300 Family, VRX320 Subfamily.

	endchoice

	config BUILD_SEPARATE_NONBONDED_BINS
		bool "Build separate non-bonded binaries"
		default n
		help
		  This option builds non-bonded binaries separately under rootfs apart from bonded binaries

	config VRX_MAX_DEVICE
		string
		prompt "Max. number of devices"
		default "1"
		help
		  Defines the max. number of VRX devices used.
		  Set it to 2 for activating OFF-chip bonding.

	config VRX_LINES_PER_DEVICE
		string
		prompt "Lines per device"
		default "1"
		help
		  Defines the number of lines used per VRX devices.
		  Set it to 2 for activating ON-chip bonding.

	config dsl-cpe-mei-vrx_USE_KERNEL_BUILD_IN
		bool "Use kernel build-in"
		default n

	config dsl-cpe-mei-vrx_USE_PCI_SLAVE_DOWNLOAD
		bool "Use PCI Slave firmware download"
		default n

	config dsl-cpe-mei-vrx_MEI_PREDEF_DBG_BAR
		bool "Enable BAR debug user functionality"
		default y

	choice
		depends on dsl-cpe-mei-vrx_USE_PCI_SLAVE_DOWNLOAD
		prompt "PCI Slave address range"
		default dsl-cpe-mei-vrx_USE_PCI_SLAVE_ADDR_RANGE_ADTRAN
	config dsl-cpe-mei-vrx_USE_PCI_SLAVE_ADDR_RANGE_ADTRAN
		bool "ADTRAN"
	config dsl-cpe-mei-vrx_USE_PCI_SLAVE_ADDR_RANGE_BONDING
		bool "BONDING"
    	endchoice
endmenu
```

## package/minidlna/Config.in
```kconfig
config MINIDLNA_MODELNAME
	string
	prompt "Model name of the UPnP MediaServer in router"
	default "Windows Media Connect compatible (ReadyDLNA)"
	help
	  Model name of the UPnP MediaServer in router, such as "Windows Media Connect compatible (NETGEAR WNDR3800)"
```

## package/net-cgi/Config.in
```kconfig
#config HAVE_MACRO
#	bool "compile feature MACRO into gui binary"
#	default n
#	help
#	  help message of feature MACRO
#
#config STRING_MACRO
#	string "specify MACRO's value"
#	default ""
#	help
#	  help message of MACRO

config net-cgi_USE_NEW_SOURCE
	bool "Use new source code to compile"
	default y
	help
	  please select it if you want compile net-cgi/src.new

config net-cgi_HAVE_DSL
	bool "DSL feature"
	default n
	help
	  please select it if the project support DSL feature

config net-cgi_HAVE_BROADBAND
	bool "Broadband feature"
	default n
	help
	  please select it if the project support Broadband feature

config net-cgi_HAVE_LTE
	bool "LTE feature"
	default n
	help
	  please select it if the project support LTE feature

config net-cgi_HAVE_IPv6
	bool "IPv6 feature"
	default y
	help
	  please select it if the project support IPv6 feature

config net-cgi_MULTI_OPMODE
	bool "Multiple operation mode"
	default y
	help
	  please select it if the project support multiple operation mode, like ap mode, bridge mode, extender mode.

config net-cgi_HAVE_QoS
	bool "QoS feature"
	default y
	help
	  please select it if the project support QoS feature

config net-cgi_SOAP_ON
	bool "Enable SOAP"
	default y
	help
	  please select it if the project support SOAP feature

config net-cgi_HAVE_TR069
	bool "TR069 feature"
	default n
	help
	  please select it if the project support TR069 feature

config net-cgi_USB_STORAGE
	bool "USB storage"
	default y
	help
	  please select it if the project support USB storage feature

config net-cgi_HAVE_VLAN
	bool "VLAN feature"
	default y
	help
	  please select it if the project support VLAN feature

config net-cgi_HAVE_VPN
	bool "VPN feature"
	default y
	help
	  please select it if the project support VPN feature

config net-cgi_CD_LESS
	bool "CD-less"
	default y
	help
	  please select it if the project support CD-less feature

config net-cgi_HAVE_WIFI
	bool "Wireless"
	default y
	help
	  please select it if the project have wireless

config net-cgi_HAVE_SECURITY
	bool "Security feature"
	default y
	help
	  please select it if the project support security feature

config net-cgi_HAVE_ADVANCED
	bool "Advanced feature"
	default y
	help
	  please select it if the project support advanced feature

config net-cgi_HAVE_WAN
	bool "Have WAN"
	default y
	help
	  please select it if the project have WAN interface
```

## package/net-scan/Config.in
```kconfig
config net-scan_SUPPORT_STREAMBOOST
	bool "support Streamboost"
	default y
	help
	  If your project doesn't support Streamboost, please disable it.
```

## package/wide-dhcpv6/Config.in
```kconfig
config wide-dhcpv6_KERNEL_NO_IN6_PKTINFO
	bool "define in6_pktinfo"
	default n
	help
	  it control if need define struct in6_pktinfo in wide-dhcpv6. 
	  For example:R7500/R7500v2/R7800/WNDR4500v3 with kernel 3.4.10  did not define struct in6_pktinfo, so need wide-dhcpv6_KERNEL_NO_IN6_PKTINFO.

config wide-dhcpv6_NETGEAR_getifaddrs
	bool "netgear router get addr and name about interface "
	default y
	help
	  rewrite getifaddrs for NETGEAR router (uClibc system),read file "/pro/net/in_inet6" to get the addr and interface name and use "itcol" to get MAC addr

config wide-dhcpv6_NETGEAR_lease_phase 
	bool "solicit with prefix and address"
	default y
	help
	  Write the prefix and address of solicit messages to LEASE_FILE,and send solicit messages with prefix and addr from it.when DHCP client restart=,route send that solicit.

config wide-dhcpv6_NETGEAR_reconfig 
	bool "dhcp6c support respond reconfig message"
	default y
	help
	  when recieving the dhcpv6 server reconfig message,client can processes the request and responds it

config wide-dhcpv6_NETGEAR_user_class 
	bool "support user class option"
	default y
	help
	  On the GUI,user can enter a string to be put in the class option which the router includers in its solicit,request,renew,rebind,and information-request.

config wide-dhcpv6_NETGEAR_select_server 
	bool "support dhcp6c select server"
	default y
	help
	  support select server when more than one server respond the solicit

config wide-dhcpv6_NETGEAR_dhcp6c_gw 
	bool "dhcp6c set default gateway"
	default y
	help
	  it can set default route according to the received RA after send RS

config wide-dhcpv6_NETGEAR_dhcp6c_dad
	bool "support new status DHCP6S_REPLY "
	default y
	help
	  Add a new status,which indicates is "after receivinf DHCPV6 Reply",and handle the icmpv6 NA packet.

config wide-dhcpv6_NETGEAR_dhcp6s_iata 
	bool "support IATA option"
	default y
	help
	   Server MUST support both acquires of non-temporary (IA_NA: 3) and a temporary address (IA_TA:4) from clent	  

config wide-dhcpv6_NETGEAR_script 
	bool "support run dhcp6c script"
	default y
	help
	   run dhcp6c script  when prefix timeout happens with REASON=prefix_timeout),or decline_script and so on.

config wide-dhcpv6_NETGEAR_dhcp6c_inforeq
	bool "support send information request "
	default y
	help
	  send Information Request to DHCPv6 server to query the information of DNS, SIP and NTP server address and record them.
```
